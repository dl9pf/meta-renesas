## meta-rcar-bsp/conf/layer.conf
```bitbake
# We have a conf and classes directory, add to BBPATH
BBPATH .= ":${LAYERDIR}"

# We have recipes-* directories, add to BBFILES
BBFILES += "${LAYERDIR}/recipes-*/*/*.bb \
    ${LAYERDIR}/recipes-*/*/*.bbappend"

BBFILE_COLLECTIONS += "rcar-gen3-bsp"
BBFILE_PATTERN_rcar-gen3-bsp = "^${LAYERDIR}/"
BBFILE_PRIORITY_rcar-gen3-bsp = "6"
LAYERSERIES_COMPAT_rcar-gen3-bsp = "zeus"
```
